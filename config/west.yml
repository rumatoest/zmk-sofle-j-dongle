## config/west.yml
```yaml
manifest:
  remotes:
    - name: zmkfirmware
      url-base: https://github.com/zmkfirmware
    - name: rumatoest
      url-base: https://github.com/rumatoest
    - name: englmaxi
      url-base: https://github.com/englmaxi
    - name: m165437
      url-base: https://github.com/M165437
  projects:
    - name: zmk
      remote: zmkfirmware
      revision: v0.3.0
      import: app/west.yml
    - name: zmk-dongle-display
      remote: englmaxi
      revision: v0.3
    - name: nice-view-gem
      remote: m165437
      revision: v0.3.0
  self:
    path: config
```
